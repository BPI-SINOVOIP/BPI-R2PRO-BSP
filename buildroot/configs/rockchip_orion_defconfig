## buildroot/configs/rockchip_rv1126_rv1109_weston_qt_defconfig
```kconfig
#include "base.config"
#include "base_extra.config"
#include "debug.config"
#include "audio.config"
#include "wifi.config"
#include "network.config"
#include "video_mpp.config"
#include "rv1126_rv1109_arm.config"
#include "camera.config"
#include "camera_gst.config"
#include "qt.config"
#include "display.config"
#include "video_mpp.config"
#include "video_gst.config"
#include "audio.config"
#include "audio_gst.config"
#include "test.config"
#include "bt.config"
#include "benchmark.config"
#include "qt_app.config"
BR2_CCACHE=y
BR2_PACKAGE_RKWIFIBT_AP6256=y
BR2_PACKAGE_RKNPU_USE_MINI_DRIVER=y
BR2_PACKAGE_RKNPU_USE_RKNN_API=y
BR2_PACKAGE_ISP2_IPC=y
BR2_PACKPAG_ISP2_IPC_FORCE_INSTALL_TO_ROOTFS=y
BR2_ROOTFS_OVERLAY="board/rockchip/rv1126_rv1109/fs-overlay-weston-qt/"
BR2_PACKAGE_DOSFSTOOLS_FATLABEL=y
BR2_PACKAGE_DOSFSTOOLS_FSCK_FAT=y
BR2_PACKAGE_FATRESIZE=y
BR2_PACKAGE_MESA3D=y
BR2_PACKAGE_MESA3D_GALLIUM_DRIVER_SWRAST=y
BR2_PACKAGE_MESA3D_OPENGL_EGL=y
BR2_PACKAGE_MESA3D_OPENGL_ES=y
BR2_PACKAGE_QT5BASE_GIF=y
BR2_PACKAGE_QT5BASE_USE_RGA=y
BR2_PACKAGE_QT5BASE_LINUXFB_ARGB32=y
BR2_PACKAGE_PARTED=y
BR2_PACKAGE_JSON_C=y
```

## buildroot/package/rockchip/libmali/Config.in
```kconfig
config BR2_PACKAGE_LIBMALI
	bool "rockchip libmali"
	depends on BR2_TOOLCHAIN_USES_GLIBC
	depends on BR2_aarch64 || (BR2_ARM_EABIHF && BR2_arm)
	select BR2_PACKAGE_LIBDRM
	help
	  Install the binary user-space library for the ARM Mali GPU.
	  This package requires a kernel with the ARM Mali GPU Kernel
	  Drivers enabled.

if BR2_PACKAGE_LIBMALI

comment "mali special configs"

config BR2_PACKAGE_LIBMALI_WITHOUT_CL
	bool "without OpenCL"

config BR2_PACKAGE_LIBMALI_WITH_DUMMY
	bool "with dummy platform"

comment "mali display platform"

choice
	prompt "display platform"
	default BR2_PACKAGE_LIBMALI_WAYLAND if BR2_PACKAGE_WAYLAND
	default BR2_PACKAGE_LIBMALI_X11 if BR2_PACKAGE_XORG7

config BR2_PACKAGE_LIBMALI_ONLY_CL
	bool "OpenCL only"
	depends on !BR2_PACKAGE_LIBMALI_WITHOUT_CL
	select BR2_PACKAGE_LIBMALI_HAS_OPENCL
	help
	  libmali for OpenCL only(no display platform).

config BR2_PACKAGE_LIBMALI_DUMMY
	bool "dummy"
	select BR2_PACKAGE_LIBMALI_HAS_DUMMY
	help
	  libmali for dummy platform.

config BR2_PACKAGE_LIBMALI_WAYLAND
	bool "wayland"
	depends on BR2_PACKAGE_WAYLAND
	help
	  libmali for wayland platform.

config BR2_PACKAGE_LIBMALI_X11
	bool "X11"
	depends on BR2_PACKAGE_XORG7
	select BR2_PACKAGE_LIBXCB
	select BR2_PACKAGE_XLIB_LIBX11
	help
	  libmali for X11 platform.

config BR2_PACKAGE_LIBMALI_GBM
	bool "GBM"
	select BR2_PACKAGE_LIBMALI_HAS_GBM
	help
	  libmali for GBM platform.

endchoice

comment "mali API features"

config BR2_PACKAGE_LIBMALI_HAS_EGL
	bool "OpenGL EGL"
	default y
	depends on !BR2_PACKAGE_LIBMALI_ONLY_CL
	select BR2_PACKAGE_HAS_LIBEGL

config BR2_PACKAGE_LIBMALI_HAS_EGL_WAYLAND
	bool "OpenGL EGL Wayland"
	default y
	depends on BR2_PACKAGE_LIBMALI_HAS_EGL
	depends on BR2_PACKAGE_LIBMALI_WAYLAND
	select BR2_PACKAGE_HAS_LIBEGL_WAYLAND

config BR2_PACKAGE_LIBMALI_HAS_GBM
	bool "gbm"
	default y if !BR2_PACKAGE_LIBMALI_DUMMY
	depends on !BR2_PACKAGE_LIBMALI_ONLY_CL
	select BR2_PACKAGE_HAS_LIBGBM

config BR2_PACKAGE_LIBMALI_HAS_GLES
	bool "OpenGL ES"
	default y
	depends on !BR2_PACKAGE_LIBMALI_ONLY_CL
	select BR2_PACKAGE_HAS_LIBGLES

config BR2_PACKAGE_LIBMALI_HAS_OPENCL
	bool "OpenCL"
	default y if !BR2_PACKAGE_LIBMALI_DUMMY
	depends on !BR2_PACKAGE_LIBMALI_WITHOUT_CL
	select BR2_PACKAGE_HAS_LIBOPENCL

config BR2_PACKAGE_PROVIDES_LIBEGL
	default "libmali" if BR2_PACKAGE_LIBMALI_HAS_EGL

config BR2_PACKAGE_PROVIDES_LIBGBM
	default "libmali" if BR2_PACKAGE_LIBMALI_HAS_GBM

config BR2_PACKAGE_PROVIDES_LIBGLES
	default "libmali" if BR2_PACKAGE_LIBMALI_HAS_GLES

config BR2_PACKAGE_PROVIDES_LIBOPENCL
	default "libmali" if BR2_PACKAGE_LIBMALI_HAS_OPENCL

endif
```

## buildroot/package/rockchip/mult_uvc_demo/Config.in
```kconfig
config BR2_PACKAGE_MULT_UVC_DEMO
    bool "mult_uvc_demo"
    select BR2_PACKAGE_LIBDRM
    select BR2_PACKAGE_LINUX_RGA
    select BR2_PACKAGE_MPP
    select BR2_PACKAGE_LIBV4L
    select BR2_PACKAGE_CAMERA_ENGINE
```

## buildroot/package/rockchip/rkadk/Config.in
```kconfig
config BR2_PACKAGE_RKADK
    bool "rkadk"
    select BR2_PACKAGE_RKMEDIA
    select BR2_PACKAGE_ROCKIT
    select BR2_PACKAGE_INIPARSER
    help
      rkadk
```

## buildroot/package/rockchip/rockit/Config.in
```kconfig
config BR2_PACKAGE_ROCKIT
    bool "rockit"
    select BR2_PACKAGE_MPP
    help
      rockit
```

## device/rockchip/rk356x/zboot.its
```
/*
 * Copyright (C) 2020 Rockchip Electronics Co., Ltd
 *
 * SPDX-License-Identifier: GPL-2.0
 */

/dts-v1/;
/ {
    description = "U-Boot FIT source file for arm";

    images {
        fdt {
            data = /incbin/("kernel/arch/arm64/boot/dts/rk3568-evb1-ddr4-v10-linux.dtb");
            type = "flat_dt";
            arch = "arm64";
            compression = "none";
            load = <0xffffff00>;

            hash {
                algo = "sha256";
            };
        };

        kernel {
            data = /incbin/("kernel/arch/arm64/boot/Image.lz4");
            type = "kernel";
            arch = "arm64";
            os = "linux";
            compression = "lz4";
            entry = <0xffffff01>;
            load = <0xffffff01>;

            hash {
                algo = "sha256";
            };
        };

        resource {
            data = /incbin/("kernel/resource.img");
            type = "multi";
            arch = "arm64";
            compression = "none";

            hash {
                algo = "sha256";
            };
        };
    };

    configurations {
        default = "conf";

        conf {
            rollback-index = <0x00>;
            fdt = "fdt";
            kernel = "kernel";
            multi = "resource";

            signature {
                algo = "sha256,rsa2048";
                padding = "pss";
                key-name-hint = "dev";
                sign-images = "fdt", "kernel", "multi";
            };
        };
    };
};
```

## device/rockchip/rv1126_rv1109/boot4recovery.its
```
/*
 * Copyright (C) 2020 Rockchip Electronics Co., Ltd
 *
 * SPDX-License-Identifier: GPL-2.0
 */

/dts-v1/;
/ {
    description = "U-Boot FIT source file for arm";

    images {
        fdt {
            data = /incbin/("kernel/arch/arm/boot/dts/rv1126-evb-ddr3-v10.dtb");
            type = "flat_dt";
            arch = "arm";
            compression = "none";
            load = <0xffffff00>;

            hash {
                algo = "sha256";
            };
        };

        kernel {
            data = /incbin/("kernel/arch/arm/boot/zImage");
            type = "kernel";
            arch = "arm";
            os = "linux";
            compression = "none";
            entry = <0xffffff01>;
            load = <0xffffff01>;

            hash {
                algo = "sha256";
            };
        };

		ramdisk {
			data = /incbin/("out/ramdisk");
			type = "ramdisk";
			arch = "arm";
			os = "linux";
			compression = "none";
			load = <0xffffff02>;

			hash {
				algo = "sha256";
			};
		};

        resource {
            data = /incbin/("kernel/resource.img");
            type = "multi";
            arch = "arm";
            compression = "none";

            hash {
                algo = "sha256";
            };
        };
    };

    configurations {
        default = "conf";

        conf {
            rollback-index = <0x00>;
            fdt = "fdt";
            kernel = "kernel";
            ramdisk = "ramdisk";
            multi = "resource";

            signature {
                algo = "sha256,rsa2048";
                padding = "pss";
                key-name-hint = "dev";
                sign-images = "fdt", "kernel", "ramdisk", "multi";
            };
        };
    };
};
```

## yocto/build/conf/bblayers.conf
```bitbake
# POKY_BBLAYERS_CONF_VERSION is increased each time build/conf/bblayers.conf
# changes incompatibly
POKY_BBLAYERS_CONF_VERSION = "2"

BBPATH = "${TOPDIR}"
BBFILES ?= ""

BBLAYERS ?= " \
  ${TOPDIR}/../meta-openembedded/meta-oe \
  ${TOPDIR}/../meta-openembedded/meta-python \
  ${TOPDIR}/../meta-qt5 \
  ${TOPDIR}/../meta-rust \
  ${TOPDIR}/../meta-clang \
  ${TOPDIR}/../meta-python2 \
  ${TOPDIR}/../meta-rockchip \
  ${TOPDIR}/../poky/meta \
  ${TOPDIR}/../poky/meta-poky \
  ${TOPDIR}/../poky/meta-yocto-bsp \
"

BBLAYERS += "  ${TOPDIR}/../meta-browser${@'/meta-chromium' if os.path.exists('${TOPDIR}/../meta-browser/meta-chromium') else ''}"
```

## yocto/meta-python2/conf/layer.conf
```bitbake
# We might have a conf and classes directory, append to BBPATH
BBPATH .= ":${LAYERDIR}"

# We have recipes directories, add to BBFILES
BBFILES += "${LAYERDIR}/recipes*/*/*.bb ${LAYERDIR}/recipes*/*/*.bbappend"

BBFILE_COLLECTIONS += "meta-python2"
BBFILE_PATTERN_meta-python2 := "^${LAYERDIR}/"
BBFILE_PRIORITY_meta-python2 = "7"

# This should only be incremented on significant changes that will
# cause compatibility issues with other layers
LAYERVERSION_meta-python2 = "1"

LAYERDEPENDS_meta-python2 = "core openembedded-layer"

LAYERSERIES_COMPAT_meta-python2 = "gatesgarth"

LICENSE_PATH += "${LAYERDIR}/licenses"
```
